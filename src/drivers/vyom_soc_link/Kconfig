## src/drivers/vyom_soc_link/Kconfig
```kconfig
menuconfig DRIVERS_VYOM_SOC_LINK
	bool "vyom_soc_link"
	default y if PLATFORM_POSIX
	---help---
		Vyom FC<->Vision SoC link (/proto v0). Enabled by default on POSIX so SITL can run
		the loopback tests without editing upstream board files.
```

## src/drivers/vyom_wdt/Kconfig
```kconfig
menuconfig DRIVERS_VYOM_WDT
	bool "vyom_wdt"
	default y if PLATFORM_POSIX
	---help---
		Vyom external watchdog kick (core-v1). Built on POSIX for the unit tests.
```

## src/modules/vyom_gnss_guard/Kconfig
```kconfig
menuconfig MODULES_VYOM_GNSS_GUARD
	bool "vyom_gnss_guard"
	default y if PLATFORM_POSIX
	---help---
		Vyom GNSS integrity monitor (spoofing/jamming/jump/VIO consistency).
```

## src/modules/vyom_gnss_sim/Kconfig
```kconfig
menuconfig MODULES_VYOM_GNSS_SIM
	bool "vyom_gnss_sim"
	default y if PLATFORM_POSIX
	depends on PLATFORM_POSIX
	---help---
		SIMULATION ONLY: GNSS receiver model with injectable jamming/spoofing faults.
```
